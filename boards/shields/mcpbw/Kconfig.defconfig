## boards/shields/mcpbw/Kconfig.defconfig
```kconfig
if SHIELD_MCPBW_LEFT

config ZMK_KEYBOARD_NAME
    default "MCPBW"

config ZMK_SPLIT_ROLE_CENTRAL
    default y

endif # SHIELD_MCPBW_LEFT

if SHIELD_MCPBW_LEFT || SHIELD_MCPBW_RIGHT

config ZMK_SPLIT
    default y

# if ZMK_DISPLAY

# config I2C
#    default y

#config SSD1306
#    default y

#endif # ZMK_DISPLAY

endif # SHIELD_MCPBW_LEFT || SHIELD_MCPBW_RIGHT
```

## boards/shields/mcpbw/Kconfig.shield
```kconfig
config SHIELD_MCPBW_LEFT
    def_bool $(shields_list_contains,mcpbw_left)

config SHIELD_MCPBW_RIGHT
    def_bool $(shields_list_contains,mcpbw_right)
```
